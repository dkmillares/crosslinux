## Kconfig.in
```kconfig
mainmenu "Cross Linux Build Tool -- Configure a Cross Linux Build"

# ----------------------------------------------------- System Name and Version

comment "System Name and Version"

config BRAND_NAME
    string
    default "crosslinux"
    prompt "Distribution Name"
    help
      This is the brand name of your Linux distribution, like Debian, Fedora,
      Ubuntu, etc.

config RELEASE_NAME
    string
    default "aardweevil"
    prompt "Release Name"
    help
      This is the name of the specific release of your Linux distribution,
      something like "Gnarly Narwhal", etc.

config RELEASE_VERS
    string
    default "0.0.1"
    prompt "Release Version"
    help
      Version of your Linux distribution.  This is a string, you can put
      anything you want.

# --------------------------------- Target Architecture and Build Configuration

source @@CL_LIBDIR@@/boards/Kconfig

choice
    bool
    default BLD_XBT_GLIBC
    prompt "Libc"
    help
      Select the C library that comes from your cross-tool chain.

config BLD_XBT_EGLIBC
    bool "eglibc"
    help
      Embedded GLIBC (EGLIBC) is a variant of the GNU C Library (GLIBC) that
      is designed to work well on embedded systems.

      ***** You must match this with your cross-tool chain.

      http://www.eglibc.org/home

config BLD_XBT_GLIBC
    bool "glibc"
    help
      The GNU C Library is used as the C library in the GNU systems and most
      systems with the Linux kernel.

      ***** You must match this with your cross-tool chain.

      http://www.gnu.org/software/libc/

config BLD_XBT_UCLIBC
    bool "uClibc"
    help
      uClibc (aka µClibc/pronounced yew-see-lib-see) is a C library for
      developing embedded Linux systems.  It is much smaller than the GNU C
      Library, but nearly all applications supported by glibc also work
      perfectly with uClibc.

      ***** You must match this with your cross-tool chain.

      http://www.uclibc.org/

endchoice

config LIBC_NAME
    string
    default "eglibc" if BLD_XBT_EGLIBC
    default "glibc"  if BLD_XBT_GLIBC
    default "uClibc" if BLD_XBT_UCLIBC

config XBT_DIR
    string
    default ""
    prompt "Path to Cross-tool Chain"
    help
      This is the path to the cross-tool chain directory.

config XBT_NAME
    string
    default ""
    prompt "Cross-tool Chain Name Prefix (Tuple)"
    help
      Enter the cross-tool chain name prefix (tuple) here.

      Cross-tool chain components such as gcc are called by prefixing the
      target tuple to the component name e.g, "armv7-generic-linux-gnueabi-gcc",
      wherein "armv7-generic-linux-gnueabi" is the tuple and "gcc" is the
      component.

      Some cross-tool chains have shortened names and may not use the tuple
      name, such as "armv7-gcc" or "ppc-gcc".

      If you enter "fubar" here, then the cross-tool chain will be called with
      program names like "fubar-gcc" and "fubar-as", etc.

      ***** NOTICE do NOT put a "-" on the end of the name; do NOT enter
                   something like "fubar-".

config DOWNLOAD_DIR
    string
    default "${HOME}/Download/"
    prompt "Download Cache Directory"
    help
      Crosslinux downloads source packages to cross-build.  Enter the directory
      into which to download the source packages.

      If you make this an empty string, then crosslinux will make and use a
      "pkg-src/" directory in the top-level build directory.

config RAMDISK_SIZE
    int
    default 64
    depends on ! BOARD_BEAGLEBONE
    prompt "RAM Disk Size"
    help
      This is the size in MB of the root file system for the RAM disk-based
      live CD-ROM systems.

config PARALLEL_JOBS
    bool
    default y
    prompt "Use Parallel Jobs"
    help
      This is whether make will be asked to run concurrent jobs.

      Select this and crosslinux will use a number of jobs based on the number
      of processor cores detected.

      Say no to use only one job.

config STRIP_BINS
    bool
    default y
    prompt "Strip Target Executables and Libraries"
    help
      All target executables and libraries will be striped.

# ---------------------------------------------------- User Build Customization

comment "User Build Customization"

config USER_SITE_SCRIPTS
    bool
    default n
    prompt "User Site Scripts"
    help
      User site scripts.

config USER_BUSYBOX_CFG
    bool
    default n
    prompt "User BusyBox Config"
    help
      User BusyBox configuration.

config USER_KERNEL
    string
    prompt "User Kernel"
    default ""
    help
      User kernel.

# -------------------------------------------------------------------- Packages

source @@CL_LIBDIR@@/pkg-cfg/Kconfig
```

## boards/Kconfig.in
```kconfig
comment "Target Architecture and Build Configuration"

choice
    bool
    default BOARD_PC_486
    prompt "Target Board"
    help
      Select the target board.

config BOARD_BEAGLEBONE
    bool "Beagle Bone \"White\""
    help
      The BeagleBone "White" is a low-cost, high-expansion BeagleBoard with
      an AM335x 720MHz ARM Cortex-A8 SoC.
      http://beagleboard.org/bone/
      http://www.ti.com/product/am3358
      http://en.wikipedia.org/wiki/ARM_architecture

config BOARD_MAC_G4
    bool "Macintosh G4"
    help
      Macintosh G3 or G4 (PowerPC 7xx/74xx) such as an Apple PowerMac or
      PowerBook computer.
      http://en.wikipedia.org/wiki/PowerPC_G3
      http://en.wikipedia.org/wiki/PowerPC_G4

config BOARD_PC_486
    bool "PC i486"
    help
      Generic PC compatible computer with an Intel i486 microprocessor,
      specifically the i486 instruction set, or a more capable compatible
      CPU.
      http://en.wikipedia.org/wiki/I486

config BOARD_PC_686
    bool "PC i686"
    help
      Generic PC compatible computer with an Intel Pentium Pro
      microprocessor, or a more capable compatible CPU.
      http://en.wikipedia.org/wiki/I686

config BOARD_PC_X86_64
    bool "PC x86_64"
    help
      Generic PC compatible computer with an AMD64/Intel 64 microprocessor.
      http://en.wikipedia.org/wiki/X86_64

endchoice

config BOARD
    string
    default "beagle_bone" if BOARD_BEAGLEBONE
    default "mac_g4"      if BOARD_MAC_G4
    default "pc_i486"     if BOARD_PC_486
    default "pc_i686"     if BOARD_PC_686
    default "pc_x86_64"   if BOARD_PC_X86_64

config CPU_ARCH
    string
    default "armv7"   if BOARD_BEAGLEBONE
    default "powerpc" if BOARD_MAC_G4
    default "i486"    if BOARD_PC_486
    default "i686"    if BOARD_PC_686
    default "x86_64"  if BOARD_PC_X86_64

config LINUX_ARCH
    string
    default "arm"     if BOARD_BEAGLEBONE
    default "powerpc" if BOARD_MAC_G4
    default "i386"    if BOARD_PC_486
    default "i386"    if BOARD_PC_686
    default "x86_64"  if BOARD_PC_X86_64

config CFLAGS
    string
    default "-mcpu=cortex-a8"                if BOARD_BEAGLEBONE
    default "-mcpu=powerpc -mtune=powerpc"   if BOARD_MAC_G4
    default "-march=i486 -mtune=i486 -Os"    if BOARD_PC_486
    default "-march=i686 -mtune=generic -Os" if BOARD_PC_686
    default "-m64 -Os"                       if BOARD_PC_X86_64

config LOADER
    string
    default "u-boot"   if BOARD_BEAGLEBONE
    default "yaboot"   if BOARD_MAC_G4
    default "isolinux" if BOARD_PC_486
    default "isolinux" if BOARD_PC_686
    default "isolinux" if BOARD_PC_X86_64
```

## pkg-cfg/Kconfig.in
```kconfig
# vim: syntax=kconfig

mainmenu "crosslinux-@@CL_VERSION@@ -- Configure a Cross Linux Build"

# ----------------------------------------------------- System Name and Version

menu "System Name and Version"

config BRAND_NAME
	string
	default "crosslinux"
	prompt "Distribution Name"
	---help---
	  This is the brand name of your Linux distribution, like Debian,
	  Fedora, Ubuntu, etc.

config BRAND_URL
	string
	default "www.crosslinux.org"
	prompt "Distribution Website"
	---help---
	  This is the web site for your Linux distribution.

config RELEASE_NAME
	string
	default "aardweevil"
	prompt "Release Name"
	---help---
	  This is the name of the specific release of your Linux distribution,
	  something like "Gnarlly Narwhal", etc.

config RELEASE_VERS
	string
	default "0.0.1"
	prompt "Release Version"
	---help---
	  Version of your Linux distribution.  This is a string, you can put
	  anything you want.

endmenu

# ---------------------------------- System Architecture and Boot Configuration

menu "System Architecture and Boot Configuration"
source @@CL_LIBDIR@@/pkg-cfg/Kconfig-bootcfg
source @@CL_LIBDIR@@/pkg-cfg/Kconfig-loaders
endmenu

# ------------------------------------ Cross-tool Chain and Build Configuration

menu "Cross-tool Chain and Build Configuration"
source @@CL_LIBDIR@@/pkg-cfg/Kconfig-xtcfg
endmenu

# -------------------------------------------------------------------- Packages

source @@CL_LIBDIR@@/pkg-cfg/Kconfig-pkgcfg
```

## pkg-cfg/busybox-1.21.0/Kconfig
```kconfig
config BLD_BUSYBOX_1p21p0
	bool
	default y
	prompt "Build busybox-1.21.0"
	---help---
	  Crosslinux systems use BusyBox.  You can't fly without.

config FORCE_BUSYBOX
	def_bool y
	select BLD_BUSYBOX_1p21p0

config BUSYBOX_HAS_LOSETUP
	bool
	default y if ! HAVE_UTIL_LINUX
	default n if HAVE_UTIL_LINUX = y
```

## pkg-cfg/crosslinux-basefs/Kconfig
```kconfig
config BLD_CROSSLINUX_BASEFS
	bool
	default y
	prompt "Base File System -- You must have a base file system"
	---help---
	  You must have a base file system.

config FORCE_BASEFS
	def_bool y
	select BLD_CROSSLINUX_BASEFS
```

## pkg-cfg/crosslinux-devfs/Kconfig
```kconfig
config BLD_CROSSLINUX_DEVFS
	bool
	default y
	prompt "Use a static /dev directory, or udev"
	---help---
	  Say yes for a static /dev directory with a fixed set of device nodes.
	  Say no to use udev.
```

## pkg-cfg/crosslinux-utils/Kconfig
```kconfig
config BLD_CROSSLINUX_UTILS
     bool
     default y
     prompt "Build crosslinux utilities."
     help
       Select this option to include the crosslinux utilities.  These utilities
       include (target system path are shown):

            /root/install.conf ....... config file for cl-installer
            /sbin/cl-flash ........... install live system onto flash drive
            /sbin/cl-installer ....... normal install onto drive
            /usr/bin/pacman .......... package manager
```

## pkg-cfg/dropbear-2013.58/Kconfig
```kconfig
config BLD_DROPBEAR_2013p58
     bool
     default y
     prompt "Build dropbear-2013.58"
     help
       Select this option to cross-build dropbear.  Dropbear is a small SSH v2
       server and client package.  It includes SCP for copying files between
       hosts.
```

## pkg-cfg/e2fsprogs-1.42.7/Kconfig
```kconfig
config BLD_E2FSPROGS_1p42p7
     bool
     default y
     prompt "Build e2fsprogs-1.42.7"
     help
       Select this option to cross-build e2fsprogs.

config E2FSPROGS_HAS_BLKID
    bool
    default y if ! HAVE_UTIL_LINUX
    default n if HAVE_UTIL_LINUX = y

config E2FSPROGS_HAS_FINDFS
    bool
    default y if ! HAVE_UTIL_LINUX
    default n if HAVE_UTIL_LINUX = y
```

## pkg-cfg/e2fsprogs-1.42.8/Kconfig
```kconfig
config BLD_E2FSPROGS_1p42p8
	bool
	default y
	prompt "Build e2fsprogs-1.42.8"
	---help---
	  Select this option to cross-build e2fsprogs.

config E2FSPROGS_HAS_BLKID
	bool
	default y if ! HAVE_UTIL_LINUX
	default n if HAVE_UTIL_LINUX = y

config E2FSPROGS_HAS_FINDFS
	bool
	default y if ! HAVE_UTIL_LINUX
	default n if HAVE_UTIL_LINUX = y
```

## pkg-cfg/gpm-1.20.7/Kconfig
```kconfig
config BLD_GPM_1p20p7
	bool
	default y
	prompt "Build gpm-1.20.7"
	---help---
	  Select this option to cross-build GPM, a general purpose mouse driver.
```

## pkg-cfg/kmod-13/Kconfig
```kconfig
config BLD_KMOD_13
	bool
	default n
	prompt "Build kmod-13"
	---help---
	  Select this option to cross-build kmod.
```

## pkg-cfg/kmod-16/Kconfig
```kconfig
config BLD_KMOD_16
	bool
	default n
	prompt "Build kmod-16"
	---help---
	  Select this option to cross-build kmod.
```

## pkg-cfg/lilo-23.2/Kconfig
```kconfig
config BLD_LILO_23p2
     bool
     default y
     prompt "Build lilo-23.2"
     help
       Select this option to cross-build lilo.
```

## pkg-cfg/ncurses-5.9/Kconfig
```kconfig
config BLD_NCURSES_5p9
	def_bool y

config BLD_NCURSES_LIBS
	bool
	default n
	prompt "Build ncurses-5.9 libs"
	---help---
	  Select this option to cross-build the ncurses libraries.

	  Regardless of this option and the ncurses libraries, these ncurses
	  terminfo files will be built, by a host-built program called tic, for
	  the target system (target system path are shown).

		/usr/share/terminfo/a/ansi
		/usr/share/terminfo/l/linux
		/usr/share/terminfo/r/rxvt
		/usr/share/terminfo/v/versaterm
		/usr/share/terminfo/v/vt100
		/usr/share/terminfo/v/vt200
		/usr/share/terminfo/v/vt320
		/usr/share/terminfo/x/xterm
		/usr/share/terminfo/x/xterm-color

config BLD_NCURSES_WIDEC
	bool
	default n
	depends on BLD_NCURSES_LIBS
	prompt "Build ncurses-5.9 libs with wide characters"
	---help---
	  Select this option to cross-build the ncurses libraries with wide
	  character support.  The wide-character libraries are usable in
	  multibyte and traditional 8-bit locales; the normal libraries work
	  properly only in 8-bit locales.  Wide-character and normal libraries
	  are source-compatible, but not binary-compatible. 
```

## pkg-cfg/ppp-2.4.5/Kconfig
```kconfig
config BLD_PPP_2p4p5
	bool
	default y
	prompt "Build ppp-2.4.5"
	---help---
	  Select this option to cross-build PPP.
```

## pkg-cfg/retawq-0.2.6c/Kconfig
```kconfig
config BLD_RETAWQ_0p2p6C
	bool
	default y
	prompt "Build retawq-0.2.6c"
	---help---
	  Select this option to cross-build retawq.

config RETAWQ_HAS_THREADING
	bool
	default n
	depends on BLD_RETAWQ_0p2p6C
	prompt "Build retawq-0.2.6c with threading"
	---help---
	  Select this option to cross-build retawq with threading.  You might
	  not want to use threading to minimize memory usage.
```

## pkg-cfg/udev-182/Kconfig
```kconfig
if ! BLD_CROSSLINUX_DEVFS

config BLD_UDEV_182
	bool
	def_bool y
	prompt "Use udev to manage /dev directory"
	---help---
	  Use udev to manage /dev directory.

config FORCE_UDEV
	def_bool y
	select BLD_UDEV_182

endif
```

## pkg-cfg/util-linux-2.23/Kconfig
```kconfig
config BLD_UTIL_LINUX_2p23
    bool
    default n
    prompt "Build util-linux-2.23"
    help
      Select this option to cross-build util-linux.

config HAVE_UTIL_LINUX
    bool
    default y if BLD_UTIL_LINUX_2p23 = y
    default n if ! BLD_UTIL_LINUX_2p23
```

## pkg-cfg/util-linux-2.24/Kconfig
```kconfig
config BLD_UTIL_LINUX_2p24
	bool
	default n
	prompt "Build util-linux-2.24"
	---help---
	  Select this option to cross-build util-linux.

config HAVE_UTIL_LINUX
	bool
	default y if BLD_UTIL_LINUX_2p24 = y
	default n if ! BLD_UTIL_LINUX_2p24
```
